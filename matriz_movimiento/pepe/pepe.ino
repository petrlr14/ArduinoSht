int matriz[6][88]={
  
  {1,1,0,0,1,1,0,0,0,1,1,1,1,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0,0},
  {1,1,0,0,1,1,0,0,1,1,0,0,1,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0,0},
  {1,1,1,1,1,1,0,0,1,1,0,0,1,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0,0},
  {1,1,0,0,1,1,0,0,1,1,0,0,1,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0,0},
  {1,1,0,0,1,1,0,0,1,1,0,0,1,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0,0},
  {1,1,0,0,1,1,0,0,0,1,1,1,1,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0,0}   
 
};

void limpiar() 
{           
//Los pines de las filas se ponen en LOW.  
for (int i=0;i<6;i++)
 {  
  digitalWrite(i,LOW);
 }
//Los pines de columnas se ponen en HIGH.  
for (int i=6;i<12;i++)
 {  
  digitalWrite(i,HIGH);
 }   
}

void setup()
{
  for(int i=0; i<12; i++){
    pinMode(i, OUTPUT);
  }
}

void loop()
{
for(int h=0; h<82; h++){
    for(int i=0; i<200; i++){
      for(int j=0; j<6; j++){
        digitalWrite(j, HIGH);
          for(int k=6; k<12; k++){
            if(matriz[j][k-6+h]==1){
              digitalWrite(k, LOW);
            }
          }
          limpiar();
      }
    }
    
  }
}
